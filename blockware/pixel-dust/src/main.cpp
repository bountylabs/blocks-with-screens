#include <DefaultConfig.h>
#define SERIALLOG 1
#include <DLog.h>
#include <Adafruit_SSD1351.h>
#include <SPI.h>
#include <Adafruit_PixelDust.h>
#include <Colors.h>
#include <WiFi.h>

// In 80MHz mode, we can do 100 grains at about 120FPS
// In 160MHz mode, we can do 100 grains at about 185FPS which feels nice

#define N_GRAINS    100 // Number of grains of sand
#define MAX_FPS     185 // Maximum redraw rate, frames/second
#define ELASTICITY  128 // Bounciness (0-255)

// Sand object, last 2 args are accelerometer scaling and grain elasticity
Adafruit_PixelDust sand(SCREEN_WIDTH, SCREEN_HEIGHT, N_GRAINS, 1, ELASTICITY);

Adafruit_SSD1351 *tft;

void displayReset() {
  tft->fillScreen(BLACK);
  tft->setCursor(0, 0);
}

// Colors for each one of the grains
uint16_t colors[N_GRAINS];

typedef struct {
  dimension_t x;
  dimension_t y;
} point;
point grains[N_GRAINS];

// Twitter logo in blue
int larryWidth = 40;
int larryHeight = 33;
unsigned char larry[] = {
  0x00, 0x00, 0x00, 0x00, 0x00, 0x00, 0x00, 0x00, 0x00, 0x00, 0x00, 0x00, 0x00,
  0x00, 0x00, 0x00, 0x00, 0x00, 0x00, 0x00, 0x00, 0x00, 0x00, 0x00, 0x00, 0x00,
  0x00, 0x00, 0x00, 0x00, 0x00, 0x00, 0x00, 0x00, 0x00, 0x00, 0x00, 0x00, 0x00,
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  0x00, 0x00, 0x00, 0x00, 0x00, 0x00, 0x00, 0x00, 0x00, 0x00, 0x00, 0x00, 0x00,
  0x00};

// Accelerometer
#if defined(ACCEL_LIS2DW12)
#include <LIS2DW12Sensor.h>
#define ACCEL_ADDR 0x31U
LIS2DW12Sensor* accel;
#elif defined(ACCEL_MMA8452Q)
#include <SparkFun_MMA8452Q.h>
#define ACCEL_ADDR 0x1C
MMA8452Q accel(ACCEL_ADDR);
#endif

// Used for frames-per-second throttle
    uint32_t prevTime = 0;

uint32_t frameCounter = 0;
uint32_t lastFrameMessage = 0;

int begin_retval;


void setup(void) {
  setCpuFrequencyMhz(240);
  log_d("CPU Running at %dMHz", getCpuFrequencyMhz());
  Serial.begin(SERIAL_DATA_RATE);
  Wire.begin(SDA_PIN, SCL_PIN);

  if(!sand.begin()) {
        log_e("sand.begin error");
  }

#if defined(ACCEL_LIS2DW12)
  accel = new LIS2DW12Sensor(&Wire, ACCEL_ADDR);
  // if (!accel->begin()) err(250);
  accel->Enable_X();
#elif defined(ACCEL_MMA8452Q)
  if (!accel.begin(Wire, ACCEL_ADDR)) {
    log_e("Accelerometer error");
  };

#endif

  SPIClass *spi = new SPIClass();
  spi->begin(SCLK_PIN, -1, MOSI_PIN, CS_PIN);
  tft = new Adafruit_SSD1351(SCREEN_WIDTH, SCREEN_HEIGHT, spi, CS_PIN, DC_PIN, RST_PIN);
  tft->begin(SPI_SPEED);

  log_e("Setup complete");

  pinMode(BUTTON_A, INPUT_PULLUP);
  pinMode(BUTTON_B, INPUT_PULLUP);
  pinMode(BUTTON_UP, INPUT_PULLUP);
  pinMode(BUTTON_DOWN, INPUT_PULLUP);
  pinMode(BUTTON_LEFT, INPUT_PULLUP);
  pinMode(BUTTON_RIGHT, INPUT_PULLUP);
  pinMode(BUTTON_SELECT, INPUT_PULLUP);
  pinMode(BUTTON_START, INPUT_PULLUP);

  // Max is 700000 in 160MHz mode and 400000 in 80MHz mode
  Wire.setClock(700000); // Run I2C at 700 KHz for faster screen updates

  // Clear the display
  displayReset();

  // Draw an obstacle for sand to move around
  dimension_t larryStartY = (SCREEN_HEIGHT - larryHeight) / 2;
  dimension_t larryStartX = (SCREEN_WIDTH - larryWidth) / 2;
  for (uint8_t y = 0; y < larryHeight; y++) {
    for (uint8_t x = 0; x < larryWidth; x++) {
      uint16_t color = ((uint16_t *)larry)[y * larryWidth + x];
      if (color > 0) {
        sand.setPixel(larryStartX + x, larryStartY + y);             // Set pixel in the simulation
      }
      tft->drawPixel(larryStartX + x, larryStartY + y, color);
    }
  }

  // Create some colors
  for (int i = 0; i < N_GRAINS; i ++) {
    colors[i] = randomColor();
  }

  sand.randomize(); // Initialize random sand positions

  lastFrameMessage = micros();

  // WiFi.begin("Boiles", "stinaissohot");
}

void loop() {
  // Limit the animation frame rate to MAX_FPS. Because the subsequent sand
  // calculations are non-deterministic (don't always take the same amount
  // of time, depending on their current states), this helps ensure that
  // things like gravity appear constant in the simulation.
  uint32_t t;
  while(((t = micros()) - prevTime) < (1000000L / MAX_FPS));
  prevTime = t;

  uint8_t i;
  dimension_t x, y;

  // Display frame calculated on the prior pass.  It's done immediately after the
  // FPS sync (rather than after calculating) for consistent animation timing.
  tft->startWrite();
  for(i = 0; i < N_GRAINS; i++) {
    // Clear the old position of the grain
    tft->setAddrWindow(grains[i].x, grains[i].y, 1, 1);
    tft->SPI_WRITE16(BLACK);

    sand.getPosition(i, &x, &y);

    // Write the new position of the pixel
    tft->setAddrWindow(x, y, 1, 1);
    tft->SPI_WRITE16(colors[i]);

    // Save the grain position so we can erase it after the next iteration
    grains[i] = {x, y};
  }
  tft->endWrite();

  // Read accelerometer and run the physics

#if defined(ACCEL_LIS2DW12)
  int16_t axes[3];
  accel->Get_X_AxesRaw(axes);
  sand.iterate((int)-axes[0], (int)-axes[1], (int)-axes[2]);
#elif defined(ACCEL_MMA8452Q)
  // Wait for the accelerometer to become ready
  while (!accel.available()) {}
  // Read accelerometer and run the physics
  accel.read();
  // log_d("accel.read() %d %d %d", accel.x, accel.y, accel.z);
  sand.iterate((int)(accel.x), (int)(-accel.y), (int)(accel.z));
#endif

  // Log the FPS for debugging once per second
  frameCounter++;
  if ((t - lastFrameMessage) > 1000000L) {
    DLOG("FPS: %f", (float)frameCounter/((t - lastFrameMessage)/1000000.0));
    frameCounter = 0;
    lastFrameMessage = t;
  }

  if (digitalRead(BUTTON_A) == LOW) {
    log_d("Button A pressed");
    sand.iterate(-232, 10310, 910);
  }
  if (digitalRead(BUTTON_B) == LOW) {
    log_d("Button B pressed");
    sand.iterate(-34, -10300, 910);
  }
  if (digitalRead(BUTTON_UP) == LOW) {
    log_d("Button UP pressed");
    sand.iterate(-34, -10300, 910);
  }
  if (digitalRead(BUTTON_DOWN) == LOW) {
    log_d("Button DOWN pressed");
    sand.iterate(-232, 10310, 910);
  }
  if (digitalRead(BUTTON_LEFT) == LOW) {
    log_d("Button LEFT pressed");
    sand.iterate(-10232, 310, 910);
  }
  if (digitalRead(BUTTON_RIGHT) == LOW) {
    log_d("Button RIGHT pressed");
    sand.iterate(10232, 310, 910);
  }
  if (digitalRead(BUTTON_SELECT) == LOW) {
    log_d("Button SELECT pressed");
  }
  if (digitalRead(BUTTON_START) == LOW) {
    log_d("Button START pressed");
  }
}
